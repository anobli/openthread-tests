## prj.conf
```kconfig
# SPDX-License-Identifier: Apache-2.0

# Increased main stack size required for initialization
CONFIG_MAIN_STACK_SIZE=4096
# 
# Enable Networking and OpenThread stack
CONFIG_NETWORKING=y
CONFIG_NET_L2_OPENTHREAD=y
# 
# Use NVS as settings backend
CONFIG_NVS=y

# Logging
CONFIG_LOG=y
CONFIG_NET_LOG=y

# Networking and OpenThread shells
CONFIG_SHELL=y
CONFIG_NET_SHELL=y
CONFIG_OPENTHREAD_SHELL=y
CONFIG_OPENTHREAD_JOINER=y
CONFIG_OPENTHREAD_COAP=y
CONFIG_OPENTHREAD_COMMISSIONER=y
CONFIG_OPENTHREAD_DHCP6_CLIENT=y
CONFIG_OPENTHREAD_PING_SENDER=y
CONFIG_OPENTHREAD_OPERATIONAL_DATASET_AUTO_INIT=y
CONFIG_OPENTHREAD_SETTINGS_RAM=y
CONFIG_OPENTHREAD_MANUAL_START=y

CONFIG_PRINTK=y
CONFIG_SHELL=y
CONFIG_LOG=y
CONFIG_SHELL_BACKEND_SERIAL=y
CONFIG_KERNEL_SHELL=y
```

## src/main.c
```c
/*
 * Copyright (c) 2025 Alexandre Bailon
 *
 * SPDX-License-Identifier: Apache-2.0
 */

int main(void)
{
	return 0;
}
```
