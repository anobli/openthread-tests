## tests/openthread_shell/testcase.yaml
```yaml
common:
  harness: pytest
  harness_config:
    pytest_dut_scope: session
    fixture: openthread_border_router
  tags:
    - net
    - openthread
  depends_on: openthread
sample:
  description: Test Thread and IEEE 802.15.4 using the OpenThread shell
  name: OpenThread Shell
tests:
  sample.net.openthread.shell:
    platform_allow:
      - cc1352p7_lp/cc1352p7
    integration_platforms:
      - cc1352p7_lp/cc1352p7
```

## west.yml
```yaml
manifest:
  self:
    west-commands: scripts/west-commands.yml

  remotes:
    - name: zephyrproject-rtos
      url-base: https://github.com/zephyrproject-rtos

  projects:
    - name: zephyr
      remote: zephyrproject-rtos
      revision: main
      import:
        path-prefix: third-party
        # By using name-allowlist we can clone only the modules that are
        # strictly needed by the application.
        name-allowlist:
          - cmsis_6    # required by the ARM port for Cortex-M
          - hal_ti
          - mbedtls
          - openthread
          - tf-psa-crypto
```
